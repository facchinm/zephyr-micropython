## samples/micropython/shell/boards/nrf54l15dk_nrf54l15_cpuapp.conf
```kconfig
CONFIG_FLASH=y
CONFIG_FLASH_MAP=y
CONFIG_FILE_SYSTEM=y
CONFIG_FILE_SYSTEM_SHELL=y
CONFIG_FILE_SYSTEM_LITTLEFS=y
CONFIG_FS_LITTLEFS_FC_HEAP_SIZE=8192
CONFIG_SHELL_ARGC_MAX=64
CONFIG_MAIN_STACK_SIZE=4096
```

## west.yml
```yaml
# Copyright (c) 2025 Nordic Semiconductor ASA
# SPDX-License-Identifier: Apache-2.0

manifest:
  remotes:
    - name: zephyr-upstream
      url-base: https://github.com/zephyrproject-rtos

    - name: bjarki-andreasen
      url-base: https://github.com/bjarki-andreasen

  projects:
    - name: zephyr
      remote: zephyr-upstream
      revision: v4.3.0
      import: true

    - name: micropython
      remote: bjarki-andreasen
      revision: aceafd9e98151dd6f32ff142055947f0f32beeda
      path: modules/lib/micropython
      submodules:
        - path: lib/micropython-lib

  self:
    path: zephyr-micropython
```
